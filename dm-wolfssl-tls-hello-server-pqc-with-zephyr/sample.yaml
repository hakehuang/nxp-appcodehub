## dm-wolfssl-tls-hello-server-pqc-with-zephyr/sample.yaml
```yaml
sample:
  description: A hello server that uses the ethernet avaliable for the FRDM-MCXN947
  name: TLS 1.3 Hello Server
tests:
  sample.basic.wolfssl.tls_hello_pqc:
    tags:
      - Ethernet
      - Networking
      - TLS 1.3
```
